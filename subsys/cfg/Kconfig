## subsys/cfg/Kconfig
```kconfig
menu "Config storage (subsys/cfg)"

    config CFG_MAX_HANDLES
        int "Maximum simultaneously open namespaces"
        default 8
        range 1 32
        help
            Size of the static handle table behind cfg_open(). One per subsystem that
            keeps a namespace open is typical. Exhaustion returns ESP_ERR_NO_MEM at
            open time (ADR-005).

    config CFG_MAX_BLOB_BYTES
        int "Maximum payload of a versioned blob (bytes)"
        default 1024
        range 16 4000
        help
            Upper bound for cfg_set_blob(). Sizes a static scratch buffer of this many
            bytes plus an 8-byte header. NVS itself limits a single blob to just under
            4000 bytes on a default page size.

endmenu
```

## subsys/diag/Kconfig
```kconfig
menu "Diagnostics (subsys/diag)"

    config DIAG_MAX_WDT_TASKS
        int "Maximum tasks subscribed to the task watchdog through diag"
        default 8
        range 1 32
        help
            Size of the static table that records which tasks diag_task_register()
            subscribed, so diag_deinit() can unsubscribe exactly those. Deadline
            tasks (audio capture, USB device) are the intended subscribers.

    config DIAG_WDT_TIMEOUT_S
        int "Task watchdog timeout used when diag initialises the WDT itself (s)"
        default 5
        range 1 60
        depends on ESP_TASK_WDT_EN && !ESP_TASK_WDT_INIT
        help
            When the system does not initialise the task watchdog at boot
            (ESP_TASK_WDT_INIT off), diag_task_register() initialises it on first use
            with this timeout. When ESP_TASK_WDT_INIT is on, the system's
            ESP_TASK_WDT_TIMEOUT_S applies and this symbol is hidden.

endmenu
```

## subsys/ota/Kconfig
```kconfig
menu "OTA update (subsys/ota)"

    config OTA_TASK_PRIORITY
        int "OTA worker task priority"
        default 5
        range 1 15
        help
            Well below USB (18) and audio (20): a multi-megabyte download must never
            starve a deadline task (FW-OTA-010).

    config OTA_TASK_CORE
        int "OTA worker task core affinity"
        default 0
        range 0 1
        help
            Core 0, alongside the network stacks it talks to (ADR-009).

    config OTA_TASK_STACK
        int "OTA worker task stack (bytes)"
        default 8192
        range 6144 16384
        help
            TLS handshakes need depth. Reducing below 8 KiB risks overflow during
            certificate verification.

    config OTA_HTTP_TIMEOUT_MS
        int "HTTP request timeout (ms)"
        default 10000
        range 1000 120000

    config OTA_RECV_BUFFER_SIZE
        int "HTTP receive buffer (bytes)"
        default 4096
        range 1024 16384
        help
            Download chunk size; trades RAM against flash-write efficiency. 4096
            matches the flash sector.

    config OTA_PROGRESS_INTERVAL_BYTES
        int "Emit OTA_EVT_PROGRESS every N bytes"
        default 65536
        range 4096 1048576

endmenu
```

## subsys/pm_policy/Kconfig
```kconfig
menu "PM Policy (subsys/pm_policy)"

    config PM_POLICY_MAX_LOCKS
        int "Maximum number of named deep-sleep locks"
        default 8
        range 1 64
        help
            Size of the statically allocated lock table used by
            pm_policy_lock_create(). No dynamic allocation is used, so this bounds
            how many distinct subsystems can each hold a named deep-sleep lock.
            Each entry costs 12 bytes of BSS. Exhaustion fails loudly at init time
            with ESP_ERR_NO_MEM (FW-PMP-003) - a deterministic, immediate failure by
            design (ADR-005).

endmenu
```

## subsys/power/Kconfig
```kconfig
menu "Power (subsys/power)"

    config POWER_ENABLE_DFS
        bool "Enable dynamic frequency scaling on power_init()"
        depends on PM_ENABLE
        default y
        help
            Calls esp_pm_configure() during power_init() so the CPU can scale
            between POWER_MIN_FREQ_MHZ and POWER_MAX_FREQ_MHZ. Requires
            "Component config > Power Management > Support for power management"
            (PM_ENABLE). When PM_ENABLE is off this symbol does not exist and the
            entire DFS path compiles out (FW-PWR-002).

    config POWER_MAX_FREQ_MHZ
        int "Max CPU frequency (MHz) for DFS"
        depends on POWER_ENABLE_DFS
        default 240
        range 80 240
        help
            Upper DFS bound. 240 is the ESP32-S3 maximum. Lowering it caps peak
            throughput and peak current.

    config POWER_MIN_FREQ_MHZ
        int "Min CPU frequency (MHz) for DFS"
        depends on POWER_ENABLE_DFS
        default 80
        range 10 240
        help
            Lower DFS bound. Lowering it saves idle power but lengthens wake-from-idle
            latency, and a peripheral clocked from a scaled source may misbehave
            (SYS-PWR-007). 80 MHz keeps the APB clock at its nominal 80 MHz on the
            ESP32-S3; values below that scale APB too.

    config POWER_LIGHT_SLEEP_AUTO
        bool "Let esp_pm enter light sleep automatically when idle"
        depends on POWER_ENABLE_DFS && FREERTOS_USE_TICKLESS_IDLE
        default n
        help
            Sets light_sleep_enable in the esp_pm configuration. Requires tickless
            idle. Off by default because automatic light sleep interacts with USB
            and I2S; enable it deliberately after measuring (SYS-PWR-009).

    config POWER_LIGHT_SLEEP_ALLOW_WITH_USJ
        bool "Allow light sleep while a USB-Serial/JTAG host is connected"
        depends on SOC_USB_SERIAL_JTAG_SUPPORTED
        default n
        help
            On the ESP32-S3 the USB-Serial/JTAG link cannot survive light sleep: the
            pad is disabled on entry and the host never re-enumerates afterwards, so a
            board whose only console is USJ becomes unreachable until re-plugged.
            While this is off, power_enter_light_sleep() returns ESP_ERR_NOT_ALLOWED
            whenever usb_serial_jtag_is_connected() is true. Turn it on only for
            production builds that do not rely on the USJ console.

    config POWER_RETAINED_PAYLOAD_BYTES
        int "Bytes of application state retained across deep sleep"
        default 256
        range 16 4096
        help
            Size of the payload in the CRC-protected RTC slow memory block managed by
            power_retained_read()/write(). RTC slow memory is 8 KiB on the ESP32-S3
            and ESP-IDF reserves part of it; keep this well under 4 KiB.

endmenu
```

## subsys/usb_audio/Kconfig
```kconfig
menu "USB Audio (subsys/usb_audio)"

    config USB_AUDIO_FEED_PERIOD_US
        int "Feeder period (us)"
        default 1000
        range 250 4000
        help
            How often the feeder task moves bytes from the ring into TinyUSB's
            software FIFO while streaming. 1000 us matches the USB frame. Shorter
            lowers latency at the cost of wakeups; longer relies on the FIFO
            (CONFIG_TINYUSB_AUDIO_EP_IN_SW_BUF_MULT) to bridge the gap.

    config USB_AUDIO_FEED_TASK_PRIORITY
        int "Feeder task priority"
        default 19
        range 1 24
        help
            Between audio capture (20) and the USB device task (18): the feeder must
            run as soon as capture publishes, but never delay capture itself.

    config USB_AUDIO_FEED_TASK_CORE
        int "Feeder task core affinity"
        default 1
        range 0 1
        help
            Same core as capture and USB so the whole audio path is isolated from
            the radio stacks on core 0 (ADR-009).

    config USB_AUDIO_FEED_TASK_STACK
        int "Feeder task stack (bytes)"
        default 3072
        range 2048 8192

    config USB_AUDIO_SPEAKER_TARGET_MS
        int "Speaker: backlog the feedback servo holds in the playback ring (ms)"
        default 12
        range 2 200
        depends on TINYUSB_AUDIO_SPEAKER_ENABLED
        help
            The setpoint the asynchronous-sink servo regulates (ADR-021). It is the
            latency the USB path adds on top of the playback driver's own prefill,
            so keep it small; but it must stay above that prefill, or the two
            controllers fight - audio_playback re-enters prefill whenever the ring
            runs dry, which the servo then reads as "send faster".

            Rule of thumb: CONFIG_AUDIO_PLAYBACK_PREFILL_MS plus a couple of
            milliseconds of host jitter.

    config USB_AUDIO_SPEAKER_FB_PERIOD_MS
        int "Speaker: feedback recomputation period (ms)"
        default 16
        range 1 128
        depends on TINYUSB_AUDIO_SPEAKER_ENABLED
        help
            The backlog is sampled every feeder tick and averaged over this period
            before a new feedback value is sent. Averaging is what keeps host jitter
            out of the servo; too short and the value chatters, too long and genuine
            drift is corrected slowly. The endpoint keeps sending the last value
            every frame regardless, so this is the servo's period, not the wire's.

endmenu
```

## subsys/usb_device/Kconfig
```kconfig
menu "USB Device (subsys/usb_device)"

    config USB_DEVICE_VID
        hex "USB vendor ID"
        default 0x303A
        help
            0x303A is Espressif's vendor ID, acceptable for development with a
            PID from Espressif's test range. A shipping product needs its own
            VID/PID (TBD-006, SYS-USB-007).

    config USB_DEVICE_PID
        hex "USB product ID"
        default 0x4004
        help
            Product ID paired with USB_DEVICE_VID. See TBD-006.

    config USB_DEVICE_MANUFACTURER
        string "Manufacturer string"
        default "ESP32-S3 Platform SDK"

    config USB_DEVICE_PRODUCT
        string "Product string"
        default "Composite Audio+HID Device"

    config USB_DEVICE_MAX_FUNCTIONS
        int "Maximum registered class functions"
        default 4
        range 1 8
        help
            Static registry size. The hardware endpoint budget (4 IN endpoints)
            is usually the binding limit before this is.

    config USB_DEVICE_CONFIG_DESC_MAX_BYTES
        int "Configuration descriptor buffer size (bytes)"
        default 512
        range 64 2048
        help
            Static buffer the composite configuration descriptor is assembled into.
            A UAC2 microphone plus one HID interface needs roughly 200 bytes.

    config USB_DEVICE_TASK_PRIORITY
        int "USB device task priority"
        default 18
        range 1 24
        help
            Above every application task and below audio capture (20), so a USB
            frame is never missed because an application task ran, but capture
            still wins if both are ready (SDD §8.1).

    config USB_DEVICE_TASK_CORE
        int "USB device task core affinity"
        default 1
        range 0 1
        help
            Core 0 hosts the Wi-Fi/Bluetooth stacks by ESP-IDF default; pinning
            USB to core 1 isolates the 1 ms frame deadline from radio activity
            (ADR-009).

    config USB_DEVICE_TASK_STACK
        int "USB device task stack (bytes)"
        default 4096
        range 2048 16384

    # The device core needs suspend/resume delivered as events to manage its sleep
    # lock; those are opt-in callbacks in esp_tinyusb.
    config USB_DEVICE_SELECTS
        bool
        default y
        select TINYUSB_SUSPEND_CALLBACK
        select TINYUSB_RESUME_CALLBACK

endmenu
```

## subsys/usb_hid/Kconfig
```kconfig
menu "USB HID (subsys/usb_hid)"

    config USB_HID_REPORT_QUEUE_LEN
        int "Input report queue depth"
        default 8
        range 1 64
        help
            Reports buffered ahead of the interrupt IN endpoint. Raising it absorbs
            more producer jitter at the cost of latency and 66 bytes of RAM per slot.
            A full queue makes usb_hid_report_send() return ESP_ERR_NO_MEM.

    config USB_HID_EP_SIZE
        int "Default interrupt IN endpoint size (bytes)"
        default 64
        range 1 64
        help
            wMaxPacketSize when usb_hid_config_t.ep_size is 0. 64 is the full-speed
            interrupt maximum and also the largest report that can be sent.

    config USB_HID_POLL_INTERVAL_MS
        int "Default bInterval (ms)"
        default 1
        range 1 255
        help
            Host polling interval when usb_hid_config_t.poll_interval_ms is 0. On
            full-speed USB one frame is 1 ms, so 1 is the hardware floor (CON-02,
            SYS-HID-001). Larger values reduce bus load and host CPU at the cost of
            report latency.

endmenu
```

## subsys/wifi_link/Kconfig
```kconfig
menu "Wi-Fi link (subsys/wifi_link)"

    config WIFI_LINK_POWER_SAVE_MIN_MODEM
        bool "Enable modem power save (WIFI_PS_MIN_MODEM)"
        default y
        help
            Lets the Wi-Fi modem sleep between DTIM beacons while connected.
            Reduces idle current substantially; adds latency to inbound traffic.
            Turn off for latency-sensitive network use.

endmenu
```

## tests/drivers/lsm6dsv16x/main/Kconfig.projbuild
```kconfig
menu "Test: lsm6dsv16x"

    config TEST_ON_ORGA
        bool "Running on an ORGA v1 board (IMU present)"
        default n
        help
            Runs the [needs_orga] cases, which need the real IMU, and skips the
            [no_imu] case, which asserts that nothing answers at 0x6A.
endmenu
```

## tests/drivers/tlv320aic3104/main/Kconfig.projbuild
```kconfig
menu "Test: tlv320aic3104"

    config TEST_ON_ORGA
        bool "Running on an ORGA v1 board (codec present)"
        default n
        help
            Runs the [needs_orga] cases, which need the real codec, and skips the
            [no_codec] case, which asserts that nothing answers at 0x18.
endmenu
```

## tests/subsys/usb_device/main/Kconfig.projbuild
```kconfig
menu "usb_device test options"

    config TEST_USB_HOST_ATTACHED
        bool "Run ONLY the bus-attaching tests"
        default n
        help
            The default build runs every case that does not touch the USB bus, so
            it is safe on a board whose only console is USB-Serial/JTAG.

            With this set, app_main() runs only the [needs_usb_host] cases, which
            call usb_device_start(). On the ESP32-S3 that switches the PHY to OTG
            and the USJ console disappears until the board is physically replugged
            (CON-09, TBD-009). The Unity output goes with it, so the result has to
            be read from the host side - see the case's own comment.

endmenu
```
