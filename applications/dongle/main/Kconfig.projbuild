## drivers/tlv320aic3104/Kconfig
```kconfig
menu "TLV320AIC3104 codec (drivers/tlv320aic3104)"

    config TLV320AIC3104_I2C_HZ
        int "Default I2C clock (Hz)"
        default 400000
        range 10000 400000
        help
            The codec supports standard and fast mode (SLAS510G).

    config TLV320AIC3104_HP_CM
        int "Headphone output common-mode voltage code"
        default 1
        range 0 3
        help
            Register 40 D7-D6: 0 = 1.35 V, 1 = 1.5 V, 2 = 1.65 V, 3 = 1.8 V.
            Half the driver supply gives the most swing: 1.5 V for DRVDD = 3.0 V
            (ORGA v1, LP5907-3.0). Choose 1.65 V for a 3.3 V DRVDD.

    config TLV320AIC3104_POWER_ON_DELAY_CODE
        int "Output driver power-on delay code (pop reduction)"
        default 6
        range 0 11
        help
            Register 42 D7-D4: 0 = 0 s, 1 = 10 us, 2 = 100 us, 3 = 1 ms,
            4 = 10 ms, 5 = 50 ms, 6 = 100 ms, 7 = 200 ms, 8 = 400 ms,
            9 = 800 ms, 10 = 2 s, 11 = 4 s. Longer is quieter at power-up.

    config TLV320AIC3104_POWER_UP_TIMEOUT_MS
        int "How long start() waits for the drivers to report powered (ms)"
        default 1000
        range 100 10000
        help
            Must exceed the power-on delay above plus the ramp.

    config TLV320AIC3104_DEFAULT_ATTEN_HALF_DB
        int "Initial DAC attenuation (0.5 dB steps)"
        default 24
        range 0 127
        help
            24 = -12 dB: a conservative starting volume until the application
            sets its own. The application owns any hearing-safety cap.

    config TLV320AIC3104_DEFAULT_MIC_GAIN_HALF_DB
        int "Initial microphone PGA gain (0.5 dB steps)"
        default 40
        range 0 119
        help
            40 = +20 dB, a typical starting point for an electret boom mic
            biased at 2.5 V.

endmenu
```

## subsys/audio_link/Kconfig
```kconfig
menu "Wireless audio link (subsys/audio_link)"

    choice AUDIO_LINK_FRAME
        prompt "Codec frame duration"
        default AUDIO_LINK_FRAME_10MS
        help
            One frame is one packet on the air. Shorter frames cut latency and
            raise the packet rate (and header overhead); longer frames do the
            opposite. Both ends must agree: the duration is part of the format
            code every audio frame carries, and a mismatch is dropped and reported.

        config AUDIO_LINK_FRAME_5MS
            bool "5 ms"
        config AUDIO_LINK_FRAME_10MS
            bool "10 ms"
        config AUDIO_LINK_FRAME_20MS
            bool "20 ms"
    endchoice

    config AUDIO_LINK_FRAME_US
        int
        default 5000 if AUDIO_LINK_FRAME_5MS
        default 20000 if AUDIO_LINK_FRAME_20MS
        default 10000

    config AUDIO_LINK_BITRATE_STEREO
        int "Default Opus bitrate for a stereo stream (bit/s)"
        default 96000
        range 24000 160000
        help
            Used when audio_link_stream_t.bitrate_bps is 0 and the stream has two
            channels. Constant bitrate: every frame is bitrate x frame / 8 bytes,
            so this directly sets airtime per frame. 96 kbit/s at 10 ms is 120
            bytes. The ceiling keeps one frame inside one ATT payload.

    config AUDIO_LINK_BITRATE_MONO
        int "Default Opus bitrate for a mono stream (bit/s)"
        default 24000
        range 8000 96000
        help
            Used for a one-channel stream, typically the 16 kHz microphone uplink.

    config AUDIO_LINK_OPUS_COMPLEXITY
        int "Opus encoder complexity"
        default 1
        range 0 10
        help
            CPU against quality at a given bitrate; it changes the encoder only.
            Measured on target, 48 kHz stereo 10 ms frames at 96 kbit/s, 240 MHz,
            32 KiB I-cache / 64 KiB D-cache (2026-09-26):

                complexity 5: encode 7.1 ms per frame   decode 3.2 ms
                complexity 1: encode 4.9 ms per frame   decode 3.2 ms

            At 5 the dongle's stereo encode alone takes ~70 % of a core. Raise it
            only with the benchmark case of tests/subsys/audio_link showing the
            slower end still has headroom.

    config AUDIO_LINK_TASK_PRIORITY
        int "Link task priority"
        default 17
        range 1 24
        help
            Below the 1 ms audio feeders (19) and the USB device task (18), which
            share core 1: they have millisecond deadlines, while a codec frame
            that takes a few milliseconds has a whole frame of slack.

    config AUDIO_LINK_TASK_CORE
        int "Link task core affinity"
        default 1
        range 0 1
        help
            Core 1, away from the Bluedroid host on core 0 (ADR-009).

    config AUDIO_LINK_TASK_STACK
        int "Link task stack (bytes)"
        default 32768
        range 8192 65536
        help
            libopus is built with C99 variable-length arrays for its scratch
            (ADR-024), so the codec's working memory is this stack. Measured peak
            with 48 kHz stereo encode + decode on one task: 26.3 KiB at complexity
            5, 21.9 KiB at complexity 1 (2026-09-26). 24 KiB overflowed. The stats
            report the high-water mark; keep several KiB of margin.

    config AUDIO_LINK_RX_QUEUE_DEPTH
        int "Receive queue depth (frames and events)"
        default 12
        range 4 32
        help
            Frames arriving from the transport wait here for the link task. Each
            slot is about 260 bytes of static RAM.

    config AUDIO_LINK_MAX_CONCEAL_FRAMES
        int "Longest run of frames to conceal"
        default 5
        range 1 20
        help
            A sequence gap up to this many frames is filled with packet-loss
            concealment; a longer one resynchronises instead. Also caps
            consecutive concealed frames while nothing arrives, after which the
            consumer is allowed to underrun into silence.

    config AUDIO_LINK_CONCEAL_LOW_WATER_MS
        int "Conceal when the downstream backlog falls below (ms)"
        default 10
        range 0 100
        help
            With rx_backlog_cb set: when a frame is half a period overdue and the
            consumer holds less than this, one frame is concealed on the frame
            clock. Should match the playback driver's prefill.

    config AUDIO_LINK_TX_MAX_BACKLOG_MS
        int "Transmit backlog limit (ms)"
        default 40
        range 10 500
        help
            Unsent audio beyond this is discarded (and counted) rather than sent
            late: latency is bounded, and the far end conceals the gap.

    config AUDIO_LINK_CONN_INTERVAL
        int "BLE connection interval requested by the central (1.25 ms units)"
        default 8
        range 6 40
        help
            8 = 10 ms, one connection event per 10 ms frame. Shorter intervals
            cut latency and retransmission delay and cost radio-on time on the
            battery-powered peripheral.

    config AUDIO_LINK_SUPERVISION_TIMEOUT_MS
        int "BLE supervision timeout (ms)"
        default 1000
        range 200 10000
        help
            How long the link survives silence before both ends declare it lost
            and the central starts scanning again.

    config AUDIO_LINK_REQUIRE_ENCRYPTION
        bool "Require an encrypted (bonded) link"
        default y
        help
            The peripheral's downlink and CCCD refuse an unencrypted client, and
            the central pairs before it discovers the service. LE Secure
            Connections, Just Works (subsys/ble). Turning this off leaves the
            audio readable by anyone in range.

    config AUDIO_LINK_RECONNECT_DELAY_MS
        int "Central: delay before scanning again after a loss (ms)"
        default 500
        range 0 10000

    config AUDIO_LINK_CPU_FREQ_LOCK
        bool "Hold the CPU at its maximum frequency while the link is up"
        default y
        depends on PM_ENABLE
        help
            With dynamic frequency scaling the CPU otherwise idles at its minimum,
            where Opus at 48 kHz stereo may not finish a frame within a frame.

    config AUDIO_LINK_TEST_HOOKS
        bool "Test hooks (loss and reorder injection on the loopback transport)"
        default n
        help
            Adds audio_link_test_drop_next() and audio_link_test_swap_next(). For
            the on-target test project only.

endmenu
```

## subsys/ble/Kconfig
```kconfig
menu "BLE (subsys/ble)"

    config BLE_DEVICE_NAME
        string "Default advertised device name"
        default "esp32s3-sdk"
        help
            Used when ble_config_t.device_name is NULL. At most 29 bytes so that the
            complete name and the flags fit one 31-byte advertising PDU. With an
            advertised 128-bit service UUID the advertisement carries a shortened
            name and the scan response the complete one.

    config BLE_ADV_INTERVAL_MS
        int "Default minimum advertising interval (ms)"
        default 100
        range 20 10240
        help
            Longer intervals save power and lengthen discovery (SYS-SYS-018). The
            maximum defaults to 125 % of this value.

    config BLE_MAX_SERVICES
        int "Maximum GATT services an application may register"
        default 4
        range 1 8

    config BLE_LOCAL_MTU
        int "Local ATT MTU offered to the peer"
        default 247
        range 23 517
        help
            The negotiated MTU is the smaller of this and the peer's. 247 is the
            common phone maximum; notifications and writes carry MTU - 3 bytes.

    config BLE_START_TIMEOUT_MS
        int "Timeout for each step of the asynchronous start sequence (ms)"
        default 2000
        range 500 10000

    config BLE_PREFER_2M_PHY
        bool "Request the LE 2M PHY on every new link"
        default y
        help
            Halves the airtime of every packet, which is what makes a continuous
            audio stream affordable in radio-on time (ADR-022, ADR-023). A peer that
            does not support 2M simply stays on 1M; the outcome is reported as
            BLE_EVT_PHY_UPDATED. Turning it off keeps every link on 1M.

    config BLE_DATA_LEN
        int "LL data length requested on every new link (octets)"
        default 251
        range 27 251
        help
            Data Length Extension: 251 lets one link-layer packet carry a whole
            ATT payload of up to 244 bytes instead of fragmenting it into 27-byte
            pieces. 27 disables the request.

    config BLE_CONN_INTERVAL_MIN
        int "Default minimum connection interval (1.25 ms units)"
        default 24
        range 6 3200
        help
            Used by ble_connect() and ble_conn_params_request() when the caller
            passes 0. 24 = 30 ms: a general-purpose default. A streaming link asks
            for its own, shorter interval.

    config BLE_CONN_INTERVAL_MAX
        int "Default maximum connection interval (1.25 ms units)"
        default 40
        range 6 3200
        help
            40 = 50 ms. Must be at least BLE_CONN_INTERVAL_MIN.

    config BLE_SUPERVISION_TIMEOUT_MS
        int "Default supervision timeout (ms)"
        default 4000
        range 100 32000
        help
            How long a silent link survives before it is declared lost. Shorter
            detects a lost peer sooner at the cost of dropping a link through a
            brief fade.

    config BLE_SCAN_INTERVAL_MS
        int "Scan interval (ms), for scanning and connection creation"
        default 60
        range 3 10240

    config BLE_SCAN_WINDOW_MS
        int "Scan window (ms)"
        default 30
        range 3 10240
        help
            Must not exceed BLE_SCAN_INTERVAL_MS. Window/interval is the radio's
            listening duty cycle while scanning.

endmenu
```
