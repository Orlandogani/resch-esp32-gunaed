## applications/dongle/main/Kconfig.projbuild
```kconfig
menu "Application (dongle)"

    config DONGLE_ENABLE_USB
        bool "Drive the real USB host side (starts the USB device stack)"
        default n
        help
            On the ESP32-S3 the USB-OTG PHY and the built-in USB-Serial/JTAG share
            D+/D-. Starting TinyUSB removes the USJ console, and because this image
            takes the PHY about a second after every boot, replugging alone does
            not bring the port back: recovery is holding BOOT while replugging to
            reach ROM download mode (CLAUDE.md hard rule 1, TBD-009).

            n (the default) builds the console-safe dongle: host_port emulates the
            PC — a 1 kHz tone into the speaker path, following the same feedback
            law as a real host — so the radio link can be developed and soaked
            with both boards' consoles intact. y is the shipping image.

    choice DONGLE_BACKEND
        prompt "Backend at boot"
        default DONGLE_BACKEND_WLINK
        help
            What happens to the host's audio. A long press of the action button
            switches to the other backend at runtime.

        config DONGLE_BACKEND_WLINK
            bool "wlink: bridge to the headset over the wireless link"
        config DONGLE_BACKEND_TONE
            bool "tone: terminate both directions on the dongle (diagnostic)"
    endchoice

    config DONGLE_DEVICE_NAME
        string "BLE name"
        default "esp32s3-dongle"
        help
            The central's own name; the headset does not match on it.

    config DONGLE_USB_PRODUCT
        string "USB product string"
        default "Wireless Headset"
        help
            What the host shows for the audio device. VID/PID come from
            subsys/usb_device (TBD-006).

    config DONGLE_SPEAKER_SAMPLE_RATE_HZ
        int "Speaker (host -> headset) sample rate (Hz)"
        default 48000
        help
            Must equal the headset's WLINK_SPEAKER_SAMPLE_RATE_HZ (it travels in
            every audio frame's format code) and be a rate Opus codes natively:
            8000, 12000, 16000, 24000 or 48000.

    config DONGLE_SPEAKER_CHANNELS
        int "Speaker channels"
        default 2
        range 1 2

    config DONGLE_MIC_SAMPLE_RATE_HZ
        int "Microphone (headset -> host) sample rate (Hz)"
        default 16000
        help
            Must equal the headset's WLINK_MIC_SAMPLE_RATE_HZ. Mono.

    config DONGLE_SPEAKER_RING_MS
        int "Speaker ring capacity (ms)"
        default 100
        range 40 500
        help
            Holds what the host sent until the backend takes it. Must exceed
            DONGLE_PATH_TARGET_MS plus a packet (usb_audio refuses it otherwise,
            FW-AUD-059). 100 ms at 48 kHz stereo is 19200 bytes of internal RAM.

    config DONGLE_MIC_RING_MS
        int "Microphone ring capacity (ms)"
        default 100
        range 20 500

    config DONGLE_PATH_TARGET_MS
        int "Speaker path backlog setpoint (ms)"
        default 40
        range 10 200
        help
            What the host-side servo holds along the whole speaker path: what the
            dongle has not yet sent plus what the headset reports it is holding
            for playback (ADR-022). Most of it sits in the headset's playback
            ring, as the jitter buffer against radio retransmission bursts.
            Lower is lower latency and less resilience; it must stay above the
            headset's playback prefill plus one codec frame.

    config DONGLE_STATS_PERIOD_S
        int "Counter log period (s)"
        default 5
        range 1 3600

    config DONGLE_BTN_PIN_ACTION
        int "Action button GPIO (long press switches backend)"
        default 0
        help
            GPIO 0 is the BOOT button, present on every S3 devkit.

endmenu
```

## applications/gunshot-aed/main/Kconfig.projbuild
```kconfig
menu "Application (gunshot-aed)"

    config APP_ENABLE_USB
        bool "Start the USB composite device at boot"
        default n
        help
            On the ESP32-S3 the USB-OTG PHY and the built-in USB-Serial/JTAG share
            D+/D-. Starting TinyUSB removes the USJ console until the board is
            re-plugged. Leave this off while developing over USJ; turn it on for
            boards with a separate UART console or for production images.

    config APP_AUDIO_SAMPLE_RATE_HZ
        int "Microphone sample rate (Hz)"
        default 16000
        range 8000 48000

    config APP_MIC_PDM
        bool "Microphone is PDM (else standard I2S)"
        default y

    config APP_MIC_PIN_CLK
        int "Microphone clock pin (PDM CLK or I2S BCLK)"
        default 4

    config APP_MIC_PIN_WS
        int "I2S WS pin (ignored for PDM)"
        default 5

    config APP_MIC_PIN_DIN
        int "Microphone data-in pin"
        default 6

endmenu
```

## applications/headset/main/Kconfig.projbuild
```kconfig
menu "Application (headset)"

    config HEADSET_ENABLE_USB
        bool "Enter USOUND at boot (starts the USB device stack)"
        default n
        help
            On the ESP32-S3 the USB-OTG PHY and the built-in USB-Serial/JTAG share
            D+/D-. Starting TinyUSB removes the USJ console until the board is
            re-plugged — and because this image re-takes the PHY about a second
            after every boot, replugging alone does not bring COM4 back: recovery
            is holding BOOT while replugging to reach ROM download mode.

            This is the whole point of the usound profile, so it must eventually be
            y. Leave it n while developing over USJ, and turn it on only with
            someone at the board or once TBD-009 (the UART console bridge) closes.

    config HEADSET_ENABLE_WIRELESS
        bool "Compile the wireless (wlink) profile and enter it when USB is not in use"
        default y
        help
            The Phase 2 profile: duplex audio to the dongle over subsys/audio_link
            (BLE 2M PHY + Opus, ADR-022). Unlike usound it leaves the
            USB-Serial/JTAG console alone, so an image with only this enabled is
            safe to flash remotely. Needs CONFIG_BT_ENABLED.

            With both profiles compiled, USB wins at boot and a long press of the
            action button switches between them. On a board with a battery, USB
            "available" means the charger reports external power.

    config HEADSET_WIRELESS_RETRY_S
        int "Re-enter WIRELESS from IDLE after (s)"
        default 30
        range 5 3600
        depends on HEADSET_ENABLE_WIRELESS
        help
            After the dongle has been gone longer than the profile's reconnect
            grace period the headset drops to IDLE, which releases the radio and the
            stream lock so the device may sleep. It advertises again after this
            long, or at once on a press of the action button.

    # Pins are no longer here: they belong to the board (ADR-025). The devkit's old
    # HEADSET_*_PIN_* settings are BOARD_DEVKIT_* in boards/esp32s3_devkitc/board/Kconfig;
    # ORGA v1's are fixed by its copper in boards/orga_v1/board/board.c.

endmenu
```

## applications/headset/modules/hs_audio/Kconfig
```kconfig
menu "Headset: audio path (modules/hs_audio)"

    config HS_AUDIO_CODEC_RATE_HZ
        int "Codec sample rate (Hz)"
        default 48000
        help
            The rate the codec is clocked for at boot (ADC and DAC alike on the
            AIC3104). Every profile's speaker rate must equal it; the boom
            microphone is decimated from it to the profile's mic rate.

    config HS_AUDIO_MIN_ATTEN_HALF_DB
        int "Hearing-safety cap: minimum DAC attenuation (0.5 dB steps)"
        default 6
        range 0 127
        help
            The host's volume is applied to the codec but never louder than this
            much attenuation below full scale (6 = -3 dB). Set it from a
            measurement of the real drivers at full scale (TBD-018): headphone
            output level depends on driver sensitivity and impedance.

    config HS_AUDIO_INITIAL_ATTEN_HALF_DB
        int "Volume at boot, before the host sets one (0.5 dB steps of attenuation)"
        default 24
        range 0 127

    config HS_AUDIO_BOOM_GAIN_HALF_DB
        int "Boom microphone PGA gain (0.5 dB steps)"
        default 40
        range 0 119
        help
            40 = +20 dB for an electret on 2.5 V MICBIAS through 2.2 k. Tune on
            the first board with the boom actually used.

endmenu
```

## applications/headset/modules/hs_power/Kconfig
```kconfig
menu "Headset: power (modules/hs_power)"

    config HS_POWER_LOW_PERCENT
        int "Low-battery warning at or below (%)"
        default 10
        range 1 50

    config HS_POWER_CRITICAL_MV
        int "Power off on battery at or below (mV)"
        default 3400
        range 3000 3700
        help
            Above the BQ24074's and the cell's own protection, so the headset
            switches itself off cleanly (audio muted, LED shown) before brown-out
            does it noisily. The TPS63001 buck-boost holds 3.3 V well below this.

    config HS_POWER_FULL_MV
        int "With external power, treat the cell as full at or above (mV)"
        default 4150
        range 4000 4200
        help
            The charger's status pin is not wired to the S3 on ORGA v1 (TBD-015),
            so "charged" is inferred from voltage while power is good.

    config HS_POWER_RELEASE_WAIT_MS
        int "Wait at most this long for the power button's release (ms)"
        default 10000
        range 0 60000
        help
            The power button also holds the regulator on, so power cannot drop
            until it is released.

    config HS_POWER_AUTO_OFF_MIN
        int "Power off after this long not worn, on battery (min); 0 = never"
        default 15
        range 0 600
        help
            "Not worn" is the IMU reporting stillness (modules/hs_sense). With
            external power the headset never switches itself off.

endmenu
```

## applications/headset/modules/hs_ui/Kconfig
```kconfig
menu "Headset: user interface (modules/hs_ui)"

    config HS_UI_POWER_OFF_HOLD_MS
        int "Hold the power switch this long to power off (ms)"
        default 2500
        range 1000 10000
        help
            Long enough not to happen by accident in a pocket; the LED fades
            red when it fires. A shorter press shows the battery level.

    config HS_UI_WHEEL_MAX_STEPS
        int "Most volume steps one wheel event may produce"
        default 4
        range 1 32
        help
            A fast flick arrives as one event with several detents; capping it
            keeps a flick from jumping the host volume to silence or full.

    config HS_UI_WHEEL_REVERSE
        bool "Reverse the thumbwheel's sense"
        default n
        help
            Until the mechanical design fixes which way is "up" (the encoder is
            a placeholder part on ORGA v1).

endmenu
```

## applications/headset/profiles/usound/Kconfig
```kconfig
menu "Profile: usound (wired USB headset)"

    config USOUND_SPEAKER_SAMPLE_RATE_HZ
        int "Speaker sample rate (Hz)"
        default 48000
        range 8000 48000
        help
            What the UAC2 speaker interface advertises and what audio_playback is
            configured for; the two must agree or the feedback servo regulates a
            ring that is filling at a different rate than it drains. 48 kHz is what
            hosts expect of a headset and what Windows selected during the
            2026-09-22 enumeration test.

    config USOUND_SPEAKER_CHANNELS
        int "Speaker channel count"
        default 2
        range 1 2
        help
            FW-AUD-054: 1 or 2. The descriptor's channel cluster and the I2S slot
            configuration both follow this.

    config USOUND_MIC_SAMPLE_RATE_HZ
        int "Microphone sample rate (Hz)"
        default 16000
        range 8000 48000
        help
            Independent of the speaker rate: each direction has its own clock source
            entity (FW-AUD-053), which is the point of the duplex descriptor. The
            host read 16 kHz capture beside 48 kHz render on 2026-09-22.

    config USOUND_PLAYBACK_RING_MS
        int "Playback ring capacity (ms of audio)"
        default 60
        range 20 500
        help
            The elastic buffer between the USB host and the I2S clock (ADR-014). It
            must exceed CONFIG_USB_AUDIO_SPEAKER_TARGET_MS plus one packet or
            usb_audio_init() refuses the configuration (FW-AUD-059); the margin above
            that is how much host jitter the ring absorbs before the servo has to
            act. 60 ms at 48 kHz stereo 16-bit is 11520 bytes of internal RAM.

    # Speaker and microphone pins are board wiring shared by every profile:
    # see "Speaker (I2S TX) pins" / "Microphone (I2S RX) pins" in main/Kconfig.projbuild.

endmenu
```

## boards/esp32s3_devkitc/board/Kconfig
```kconfig
menu "Board: esp32s3_devkitc"

    # Provisional wiring for development on an ESP32-S3-DevKitC-1. These moved here from
    # applications/headset/main/Kconfig.projbuild (HEADSET_*_PIN_*) with their defaults
    # unchanged, when board definitions became top-level components (ADR-025).

    config BOARD_DEVKIT_BTN_VOL_DOWN
        int "Volume-down button GPIO"
        default 10
    config BOARD_DEVKIT_BTN_VOL_UP
        int "Volume-up button GPIO"
        default 11
    config BOARD_DEVKIT_BTN_ACTION
        int "Action button GPIO (BOOT)"
        default 0

    config BOARD_DEVKIT_SPK_BCLK
        int "Speaker I2S BCLK"
        default 15
    config BOARD_DEVKIT_SPK_WS
        int "Speaker I2S WS"
        default 16
    config BOARD_DEVKIT_SPK_DOUT
        int "Speaker I2S DOUT"
        default 17
    config BOARD_DEVKIT_SPK_MCLK
        int "Speaker I2S MCLK (-1 if the DAC needs none)"
        default -1
        help
            The DAC or amplifier on a devkit is whatever is wired up (TBD-010).

    config BOARD_DEVKIT_MIC_PDM
        bool "Microphone is PDM (else standard I2S)"
        default y
    config BOARD_DEVKIT_MIC_CLK
        int "Microphone PDM CLK or I2S BCLK"
        default 4
    config BOARD_DEVKIT_MIC_WS
        int "Microphone I2S WS (ignored for PDM)"
        default 5
    config BOARD_DEVKIT_MIC_DIN
        int "Microphone data in"
        default 6

endmenu
```
