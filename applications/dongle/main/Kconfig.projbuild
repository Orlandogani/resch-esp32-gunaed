## drivers/audio_capture/Kconfig
```kconfig
menu "Audio capture (drivers/audio_capture)"

    config AUDIO_CAPTURE_DMA_FRAME_MS
        int "Default milliseconds of audio per DMA descriptor"
        default 2
        range 1 20
        help
            Lower means lower capture latency and more interrupts. One descriptor
            must stay under 4092 bytes: at 48 kHz stereo 32-bit that is 10 ms.

    config AUDIO_CAPTURE_DMA_FRAME_COUNT
        int "Default DMA descriptor count"
        default 4
        range 2 16
        help
            Total DMA buffering is FRAME_MS x FRAME_COUNT. Two is the minimum for
            double-buffering (FW-AUD-002); four tolerates a late task wake-up.

    config AUDIO_CAPTURE_RING_MS
        int "Default ring buffer depth (ms)"
        default 40
        range 4 1000
        help
            Must exceed the slowest reader's service period plus USB jitter, or
            that reader is overrun (which it is told about, FW-AUD-006).

    choice AUDIO_CAPTURE_PDM_OVERSAMPLE_CHOICE
        prompt "Default PDM oversampling (PDM clock = bus rate x this)"
        default AUDIO_CAPTURE_PDM_OVERSAMPLE_64
        help
            The S3's PDM-to-PCM filter decimates by 64 (DSR_8S) or 128 (DSR_16S).
            Pick the one that puts the PDM clock inside every band the microphone
            accepts: for an IM73D122 at 16 kHz, 64 gives 1.024 MHz (out of band)
            and 128 gives 2.048 MHz (in band). A config's pdm_oversample overrides
            this per input (FW-AUD-071).

        config AUDIO_CAPTURE_PDM_OVERSAMPLE_64
            bool "64"
        config AUDIO_CAPTURE_PDM_OVERSAMPLE_128
            bool "128"
    endchoice

    config AUDIO_CAPTURE_PDM_OVERSAMPLE
        int
        default 128 if AUDIO_CAPTURE_PDM_OVERSAMPLE_128
        default 64

    config AUDIO_CAPTURE_TASK_PRIORITY
        int "Capture task priority"
        default 20
        range 1 24
        help
            Highest SDK priority: a missed DMA frame is lost irrecoverably, so
            nothing may pre-empt the drain (SDD §8.1).

    config AUDIO_CAPTURE_TASK_CORE
        int "Capture task core affinity"
        default 1
        range 0 1
        help
            Core 1, away from the Wi-Fi/Bluetooth stacks on core 0 (ADR-009).

    config AUDIO_CAPTURE_TASK_STACK
        int "Capture task stack (bytes)"
        default 4096
        range 2048 16384

endmenu
```

## drivers/audio_playback/Kconfig
```kconfig
menu "Audio playback (drivers/audio_playback)"

    config AUDIO_PLAYBACK_DMA_FRAME_MS
        int "Default milliseconds of audio per DMA descriptor"
        default 2
        range 1 20
        help
            Lower means lower output latency and more interrupts. One descriptor
            must stay under 4092 bytes, which audio_playback_init() enforces: at
            48 kHz stereo 32-bit that is 5 ms.

    config AUDIO_PLAYBACK_DMA_FRAME_COUNT
        int "Default DMA descriptor count"
        default 4
        range 2 16
        help
            Total DMA buffering is FRAME_MS x FRAME_COUNT, and is the slack the
            playback task has to refill after a late wake-up. Two is the minimum
            for double-buffering (FW-AUD-032).

    config AUDIO_PLAYBACK_PREFILL_MS
        int "Default prefill depth (ms)"
        default 10
        range 0 500
        help
            Audio that must accumulate in the source ring before playback starts,
            and again after a complete starvation. This is the hysteresis that
            stops a source running at exactly nominal rate from clicking once per
            DMA frame. It adds directly to output latency, so keep it near the
            worst-case jitter of whoever writes the ring — a USB OUT stream needs
            about one frame plus host jitter. Zero disables the hysteresis and is
            only sensible when the writer is known to run ahead.

    config AUDIO_PLAYBACK_TASK_PRIORITY
        int "Playback task priority"
        default 19
        range 1 24
        help
            Below audio_capture (20), whose losses are irrecoverable, and above
            every application task. A missed playback frame is an audible click,
            not lost data, and the DMA chain covers FRAME_MS x FRAME_COUNT of
            lateness (SDD §8.1).

    config AUDIO_PLAYBACK_TASK_CORE
        int "Playback task core affinity"
        default 1
        range 0 1
        help
            Core 1, away from the Wi-Fi/Bluetooth stacks on core 0 (ADR-009).

    config AUDIO_PLAYBACK_TASK_STACK
        int "Playback task stack (bytes)"
        default 4096
        range 2048 16384

endmenu
```

## drivers/battery/Kconfig
```kconfig
menu "Battery monitor (drivers/battery)"

    config BATTERY_SAMPLE_PERIOD_MS
        int "Default sample period (ms)"
        default 5000
        range 100 600000
        help
            A cell's voltage moves over minutes; five seconds is responsive to a
            charger being plugged in (which also wakes the task at once) without
            spending anything measurable.

    config BATTERY_AVERAGE
        int "Default moving-average length (samples)"
        default 8
        range 1 16
        help
            Smooths load transients (a radio burst, the headphone amplifier) out
            of the reading the state of charge is computed from.

    config BATTERY_ADC_MULTISAMPLE
        int "Conversions averaged per sample"
        default 16
        range 1 64

    config BATTERY_EXT_POWER_SETTLE_MS
        int "Settle time after a power-good edge (ms)"
        default 50
        range 0 1000
        help
            A connector being plugged in bounces; the level is read this long
            after the first edge.

    config BATTERY_TASK_PRIORITY
        int "Battery task priority"
        default 5
        range 1 24

    config BATTERY_TASK_CORE
        int "Battery task core affinity"
        default 0
        range 0 1

    config BATTERY_TASK_STACK
        int "Battery task stack (bytes)"
        default 3072
        range 2048 16384
        help
            The application callback runs on this stack.

endmenu
```

## drivers/buttons/Kconfig
```kconfig
menu "Buttons (drivers/buttons)"

    config BUTTONS_MAX
        int "Maximum buttons per configuration"
        default 4
        range 1 16
        help
            Size of the static per-button state table (ADR-005). buttons_init()
            rejects a configuration with more entries than this.

    config BUTTONS_DEBOUNCE_MS
        int "Default debounce time (ms)"
        default 20
        range 1 500
        help
            A level must be stable for this long before it is accepted as a press
            or release. Mechanical switches settle in 1-20 ms; raise it for a
            noisy switch, lower it for a tactile dome if latency matters.

    config BUTTONS_LONG_PRESS_MS
        int "Default long-press threshold (ms)"
        default 800
        range 100 10000
        help
            A press held this long emits BUTTONS_EVENT_LONG_PRESS once. The
            application decides what a long press means (ADR-013).

    config BUTTONS_REPEAT_MS
        int "Default auto-repeat period after a long press (ms)"
        default 200
        range 20 5000
        help
            While a button stays held past the long-press threshold and the
            configuration enables auto_repeat, BUTTONS_EVENT_REPEAT fires every
            this many milliseconds (volume-style hold).

    config BUTTONS_SAMPLE_MS
        int "Sampling period while any button is active (ms)"
        default 5
        range 1 50
        help
            After an edge interrupt the task samples every pin at this period until
            all buttons are released and settled, then blocks again. Sets the
            resolution of every timing above; must be well under DEBOUNCE_MS.

    config BUTTONS_IDLE_POLL_MS
        int "Idle wake-up period (ms)"
        default 1000
        range 100 30000
        help
            While idle the task still wakes at this period to re-sample the pins
            and feed the watchdog, so a missed edge interrupt (e.g. across a sleep
            transition) is recovered within one period. Must be below the task
            watchdog timeout (DIAG_WDT_TIMEOUT_S).

    config BUTTONS_TASK_PRIORITY
        int "Button task priority"
        default 8
        range 1 10
        help
            Human-timescale work: below every SDK deadline task (SDD §8.1). The
            application's event callback runs at this priority, on this task.

    config BUTTONS_TASK_CORE
        int "Button task core affinity"
        default 0
        range 0 1
        help
            Core 0, away from the audio deadline tasks on core 1 (ADR-009).

    config BUTTONS_TASK_STACK
        int "Button task stack (bytes)"
        default 3072
        range 2048 16384
        help
            The application's callback runs on this stack; raise it if the
            callback does more than hand the event on.

endmenu
```

## drivers/encoder/Kconfig
```kconfig
menu "Rotary encoder (drivers/encoder)"

    config ENCODER_COUNTS_PER_DETENT
        int "Default edges per detent (x4 decoding)"
        default 4
        range 1 64
        help
            4 when one click is one full quadrature cycle, which is the common
            case (Bourns PEC09: 24 pulses, 24 detents). 2 for half-cycle-per-
            detent parts; 1 for a detent-less wheel counted edge by edge.

    config ENCODER_GLITCH_NS
        int "Default glitch filter (ns)"
        default 10000
        range 0 12700
        help
            PCNT ignores pulses shorter than this. The hardware limit is 1023
            APB cycles (12.7 us at 80 MHz). Mechanical bounce outlasts this, so
            the filter is a first line only; the detent arithmetic is the second.

    config ENCODER_TASK_PRIORITY
        int "Encoder task priority"
        default 8
        range 1 24
        help
            Human-timescale work, like drivers/buttons: below every SDK deadline
            task.

    config ENCODER_TASK_CORE
        int "Encoder task core affinity"
        default 0
        range 0 1

    config ENCODER_TASK_STACK
        int "Encoder task stack (bytes)"
        default 3072
        range 2048 16384
        help
            The application callback runs on this stack.

endmenu
```

## drivers/lsm6dsv16x/Kconfig
```kconfig
menu "LSM6DSV16X IMU (drivers/lsm6dsv16x)"

    config LSM6DSV16X_I2C_HZ
        int "Default I2C clock (Hz)"
        default 400000
        range 10000 1000000

    config LSM6DSV16X_MOTION_THRESHOLD_MG
        int "Default motion threshold (mg)"
        default 62
        range 16 984
        help
            Acceleration change that counts as movement, for both the wake-up and
            the inactivity detector. 62 mg ignores desk vibration and still sees
            a head turn. Applied in 15.625 mg steps.

    config LSM6DSV16X_STILL_TIME_S
        int "Default stillness before 'still' (s)"
        default 60
        range 9 128
        help
            Quantised to 512/60 s (about 8.5 s) steps by the chip. Longer
            stillness is the application's timer.

    config LSM6DSV16X_POSE_RATE_HZ
        int "Default orientation (SFLP) rate (Hz)"
        default 30
        help
            15, 30, 60 or 120. Head tracking for spatial audio is comfortable at
            30 Hz; every sample costs an I2C read of the FIFO.

    config LSM6DSV16X_TASK_PRIORITY
        int "IMU task priority"
        default 7
        range 1 24

    config LSM6DSV16X_TASK_CORE
        int "IMU task core affinity"
        default 0
        range 0 1

    config LSM6DSV16X_TASK_STACK
        int "IMU task stack (bytes)"
        default 3584
        range 2048 16384
        help
            The application callbacks run on this stack.

endmenu
```

## drivers/power_latch/Kconfig
```kconfig
menu "Power latch (drivers/power_latch)"

    config POWER_LATCH_RELEASE_TIMEOUT_MS
        int "Default time power_latch_release() waits for power to collapse (ms)"
        default 2000
        range 100 30000
        help
            After dropping the hold pin, how long to wait before concluding that
            power is still present - because the user is still holding the power
            button, or the board has no latch at all - and re-asserting the pin.
            A working latch collapses the rail in milliseconds; this only bounds
            the failure case (FW-LAT-005).

endmenu
```

## drivers/rgb_led/Kconfig
```kconfig
menu "RGB status LED (drivers/rgb_led)"

    config RGB_LED_LEDC_TIMER
        int "LEDC timer"
        default 3
        range 0 3
        help
            Owned exclusively by this driver (DR10). Timer 3 leaves 0..2 for
            anything else that uses LEDC.

    config RGB_LED_LEDC_CHANNEL_BASE
        int "First of three consecutive LEDC channels (R, G, B)"
        default 5
        range 0 5
        help
            Channels BASE, BASE+1 and BASE+2 are owned exclusively (DR10). The
            S3 has eight low-speed channels; 5..7 is the top of the range.

    config RGB_LED_PWM_HZ
        int "Default PWM frequency (Hz)"
        default 5000
        range 100 40000
        help
            Above flicker perception and below the range where the duty
            resolution suffers.

    config RGB_LED_DUTY_BITS
        int "Duty resolution (bits)"
        default 10
        range 8 13
        help
            10 bits at 5 kHz needs a 5.12 MHz counter clock, which every LEDC
            clock source on the S3 provides.

    config RGB_LED_GAMMA
        bool "Square-law (perceptual) brightness curve"
        default y
        help
            Map an 8-bit level v to v^2/255 of full duty, so equal steps in
            level look like roughly equal steps in brightness.

    config RGB_LED_GAIN_R
        int "Default red gain (per mille of full duty)"
        default 1000
        range 1 1000

    config RGB_LED_GAIN_G
        int "Default green gain (per mille of full duty)"
        default 1000
        range 1 1000

    config RGB_LED_GAIN_B
        int "Default blue gain (per mille of full duty)"
        default 1000
        range 1 1000
        help
            The per-channel gains are the board's colour balance. A config's
            gain_permille overrides them; boards normally set these.

endmenu
```
